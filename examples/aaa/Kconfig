## examples/aaa/Kconfig
```kconfig
#
# For a description of the syntax of this configuration file,
# see the file kconfig-language.txt in the NuttX tools repository.
#

config EXAMPLES_AAA
	tristate "\"Aaa, World!\" example"
	default n
	---help---
		Enable the \"Aaa, World!\" example

if EXAMPLES_AAA

config EXAMPLES_AAA_PROGNAME
	string "Program name"
	default "AAA"
	---help---
		This is the name of the program that will be used when the NSH ELF
		program is installed.

config EXAMPLES_AAA_PRIORITY
	int "Aaa task priority"
	default 100

config EXAMPLES_AAA_STACKSIZE
	int "Aaa stack size"
	default DEFAULT_TASK_STACKSIZE

endif
```

## examples/uwb/Kconfig
```kconfig
#
# For a description of the syntax of this configuration file,
# see the file kconfig-language.txt in the NuttX tools repository.
#

config EXAMPLES_UWB
	tristate "uwb app"
	default n
	---help---
		Enable uwb app

if EXAMPLES_UWB

config EXAMPLES_UWB_PROGNAME
	string "Program name"
	default "uwb"
	---help---
		This is the name of the program that will be used when the NSH ELF
		program is installed.

config EXAMPLES_UWB_PRIORITY
	int "uwb task priority"
	default 100

config EXAMPLES_UWB_STACKSIZE
	int "uwb stack size"
	default DEFAULT_TASK_STACKSIZE

endif
```

## examples/uwb_apg/Kconfig
```kconfig
#
# For a description of the syntax of this configuration file,
# see the file kconfig-language.txt in the NuttX tools repository.
#

config EXAMPLES_UWB_APG
	tristate "\"uwbapg, World!\" example"
	default n
	---help---
		Enable the \"uwbapg, World!\" example

if EXAMPLES_UWB_APG

config EXAMPLES_UWB_APG_PROGNAME
	string "Program name"
	default "uwb_apg"
	---help---
		This is the name of the program that will be used when the NSH ELF
		program is installed.

config EXAMPLES_UWB_APG_PRIORITY
	int "uwb_apg task priority"
	default 100

config EXAMPLES_UWB_APG_STACKSIZE
	int "uwb_apg stack size"
	default DEFAULT_TASK_STACKSIZE

endif
```
